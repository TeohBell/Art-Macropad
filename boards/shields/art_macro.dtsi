    top_encoder:  top_encoder {
        compatible = "alps,ec11";
        a-gpios = <&xiao_d 6 (GPIO_ACTIVE_HIGH | GPIO_PULL_UP)>;
        b-gpios = <&xiao_d 7 (GPIO_ACTIVE_HIGH | GPIO_PULL_UP)>;
        steps = <12>;
        status = "disabled";
    };

    bott_encoder:  bott_encoder {
        compatible = "alps,ec11";
        a-gpios = <&xiao_d 21 (GPIO_ACTIVE_HIGH | GPIO_PULL_UP)>;
        b-gpios = <&xiao_d 20 (GPIO_ACTIVE_HIGH | GPIO_PULL_UP)>;
        steps = <12>;
        status = "disabled";
    };

    sensors: sensors {
        compatible = "zmk,keymap-sensors";
        sensors = <&top_encoder &bott_encoder>;
        triggers-per-rotation = <3>;
    };
